## scripts/gcc-plugins/Kconfig
```kconfig
# SPDX-License-Identifier: GPL-2.0-only
config HAVE_GCC_PLUGINS
	bool
	help
	  An arch should select this symbol if it supports building with
	  GCC plugins.

menuconfig GCC_PLUGINS
	bool "GCC plugins"
	depends on HAVE_GCC_PLUGINS
	depends on CC_IS_GCC
	depends on $(success,test -e $(shell,$(CC) -print-file-name=plugin)/include/plugin-version.h)
	default y
	help
	  GCC plugins are loadable modules that provide extra features to the
	  compiler. They are useful for runtime instrumentation and static analysis.

	  See Documentation/kbuild/gcc-plugins.rst for details.

if GCC_PLUGINS

config GCC_PLUGIN_SWMMU
	bool "SWMMU compiler instrumentation"
	depends on GCC_PLUGINS
	depends on NOMMU_SWMMU
	help
	  Enable the SWMMU GCC plugin.

	  The plugin rewrites accesses to SWMMU-annotated objects into
	  calls to nommu_swmmu_load_u64() and nommu_swmmu_store_u64().

	  SWMMU runtime failures currently terminate through BUG() in
	  the kernel and abort() in userspace. The runtime fault
	  notification ABI may require corresponding plugin changes later.


config GCC_PLUGIN_LATENT_ENTROPY
	bool "Generate some entropy during boot and runtime"
	help
	  By saying Y here the kernel will instrument some kernel code to
	  extract some entropy from both original and artificially created
	  program state.  This will help especially embedded systems where
	  there is little 'natural' source of entropy normally.  The cost
	  is some slowdown of the boot process (about 0.5%) and fork and
	  irq processing.

	  Note that entropy extracted this way is not cryptographically
	  secure!

	  This plugin was ported from grsecurity/PaX. More information at:
	   * https://grsecurity.net/
	   * https://pax.grsecurity.net/

endif
```
