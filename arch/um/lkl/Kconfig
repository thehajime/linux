## arch/um/lkl/Kconfig
```kconfig
# SPDX-License-Identifier: GPL-2.0

menu "LKL-specific options"

config UML
	bool
	default y

config UMMODE_LIB
	bool "UML mode: library mode"
	depends on !UMMODE_KERN
	select LKL
	default y if "$(UMMODE)" = "library"
	help
	  This mode switches a mode to build a library of UML (Linux
	  Kernel Library/LKL).  This switch is exclusive to "kernel mode"
	  of UML, which is traditional mode of UML.

	  For more detail about LKL, see
	  <file:Documentation/virt/uml/lkl.txt>.

config LKL
       def_bool y
       depends on !SMP && !MMU && !COREDUMP && !SECCOMP && !UPROBES && !COMPAT && !USER_RETURN_NOTIFIER
       select ARCH_THREAD_STACK_ALLOCATOR
       select RWSEM_GENERIC_SPINLOCK
       select GENERIC_ATOMIC64
       select GENERIC_HWEIGHT
       select FLATMEM
       select FLAT_NODE_MEM_MAP
       select GENERIC_CLOCKEVENTS
       select GENERIC_CPU_DEVICES
       select NO_HZ_IDLE
       select NO_PREEMPT
       select ARCH_WANT_FRAME_POINTERS
       select HAS_DMA
       select DMA_DIRECT_OPS
       select PHYS_ADDR_T_64BIT if 64BIT
       select 64BIT if "$(OUTPUT_FORMAT)" = "elf64-x86-64"
       select 64BIT if "$(OUTPUT_FORMAT)" = "elf64-x86-64-freebsd"
       select NET
       select MULTIUSER

config OUTPUT_FORMAT
       string "Output format"
       default "$(OUTPUT_FORMAT)"

config ARCH_DMA_ADDR_T_64BIT
       def_bool 64BIT

config X86_64
       def_bool y if "$(OUTPUT_FORMAT)" = "elf64-x86-64"

config X86_32
       def_bool y if "$(OUTPUT_FORMAT)" = "elf32-i386"

config 64BIT
       def_bool n

config COREDUMP
       def_bool n

config BIG_ENDIAN
       def_bool n

config GENERIC_CSUM
       def_bool LKL

config GENERIC_HWEIGHT
       def_bool y

config NO_IOPORT_MAP
       def_bool y

config RWSEM_GENERIC_SPINLOCK
	bool
	default y

config HZ
        int
        default 100

endmenu

source "arch/um/drivers/Kconfig"
```

## arch/um/lkl/um/Kconfig
```kconfig
config 64BIT
	bool
	default y

config GENERIC_CSUM
	def_bool y

config GENERIC_ATOMIC64
	bool
	default y if !64BIT

config SECCOMP
	bool
	default n

config GENERIC_HWEIGHT
	def_bool y

config PRINTK_TIME
	bool
	default y
```

## arch/um/nommu/um/Kconfig
```kconfig
config UML_NOMMU
	def_bool y
	depends on !SMP && !MMU
	select UACCESS_MEMCPY
	select ARCH_THREAD_STACK_ALLOCATOR
	select ARCH_HAS_SYSCALL_WRAPPER
	select VFAT_FS
	select NLS_CODEPAGE_437
	select NLS_ISO8859_1
	select BTRFS_FS

config 64BIT
	bool
	default y if "$(EXEC_FORMAT)" = "elf64"

config GENERIC_CSUM
	def_bool y

config GENERIC_ATOMIC64
	bool
	default y if !64BIT

config SECCOMP
	bool
	default n

config GENERIC_HWEIGHT
	def_bool y

config GENERIC_CALIBRATE_DELAY
	bool
	default n

config STACKTRACE_SUPPORT
	bool
	default n

# XXX: need this to work well with tap13.py
config PRINTK_TIME
	bool
	default y

config RAID6_PQ_BENCHMARK
	bool
	default n
```
